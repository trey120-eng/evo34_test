## config/evo34/Kconfig.defconfig
```kconfig
if SHIELD_EVO34_LEFT

# Name must be less than 16 characters long!
config ZMK_KEYBOARD_NAME
    default "Evo34"

config ZMK_SPLIT_ROLE_CENTRAL
    default y

config ZMK_SPLIT_BLE_CENTRAL_PERIPHERALS
  default 1

config BT_MAX_CONN
  default 6

config BT_MAX_PAIRED
  default 6

endif

if SHIELD_EVO34_LEFT || SHIELD_EVO34_RIGHT

config ZMK_SPLIT
    default y

endif
```
